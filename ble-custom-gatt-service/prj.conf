## CMakeLists.txt
```
# SPDX-License-Identifier: Apache-2.0

cmake_minimum_required(VERSION 3.20.0)

find_package(Zephyr REQUIRED HINTS $ENV{ZEPHYR_BASE})
project(hello_world)

target_include_directories(app PRIVATE components/ble-connection
                                        components/gpio-conf)
target_sources(app PRIVATE src/main.c
                            components/ble-connection/ble_connection.c
                            components/gpio-conf/gpio_conf.h)
```

## prj.conf
```kconfig
# nothing here
# LOG CONFIGURATION
CONFIG_LOG=y
CONFIG_LOG_BACKEND_UART=y
CONFIG_LOG_BACKEND_RTT=n
```

## src/main.c
```c
/*
 * Copyright (c) 2012-2014 Wind River Systems, Inc.
 *
 * SPDX-License-Identifier: Apache-2.0
 */

#include <zephyr/kernel.h>
#include "ble_connection.h"
#include "gpio_conf.h"

void main(void)
{
	printk("Hello World! %s\n", CONFIG_BOARD);
	ble_connection_test();
}
```
