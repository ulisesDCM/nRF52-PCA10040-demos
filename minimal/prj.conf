## CMakeLists.txt
```
cmake_minimum_required(VERSION 3.16.0)
find_package(Zephyr REQUIRED HINTS $ENV{ZEPHYR_BASE})
project(minimal)
target_sources(app PRIVATE src/main.c)
target_sources(app PRIVATE src/myMath.c)

# addition of the custom files to be conditional
target_sources_ifdef(CONFIG_MYMATH app PRIVATE src/myMath.c)
```

## Kconfig
```
source "Kconfig.zephyr"

config MYMATH
    bool "Enable my math"
    default n
    
```

## prj.conf
```kconfig
CONFIG_MYMATH=n
```

## nrf52dk_nrf52832.overlay
```dts
// To get started, press Ctrl+Space to bring up the completion menu and view the available nodes.

// You can also use the buttons in the sidebar to perform actions on nodes.
// Actions currently available include:

// * Enabling / disabling the node
// * Adding the bus to a bus
// * Removing the node
// * Connecting ADC channels

// For more help, browse the DeviceTree documentation at https://docs.zephyrproject.org/latest/guides/dts/index.html
// You can also visit the nRF DeviceTree extension documentation at https://nrfconnect.github.io/vscode-nrf-connect/devicetree/nrfdevicetree.html
&uart0 {
    current-speed = < 9600 >;
};
```

## src/main.c
```c
#include <zephyr/kernel.h>
#include <zephyr/sys/printk.h>

#include "myMath.h"

void main(void)
{
    int a,b = 0;
    
    a = 10;
    b = 20;

    while(1)
    {
        printk("Hello world!!!\n");
        
        if(!(IS_ENABLED(CONFIG_MYMATH)))
        {
            printk("MYMATH not enabled \n");
            return;
        }
        else
        {
            printk(" %d + %d = %d\n",a,b, sum(a,b));
            k_msleep(1000);
        }
    }
}
```

## src/myMath.c
```c
#include "myMath.h"

int sum(int a, int b)
{
    return a+b;
}
```

## src/myMath.h
```c
#ifndef __MY_MATH_H_
#define __MY_MATH_H_

int sum(int a, int b);

#endif
```
