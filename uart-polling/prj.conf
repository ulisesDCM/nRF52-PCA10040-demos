## CMakeLists.txt
```
cmake_minimum_required(VERSION 3.16.0)
find_package(Zephyr REQUIRED HINTS $ENV{ZEPHYR_BASE})
project(uart_polling)
target_sources(app PRIVATE src/main.c)
```

## prj.conf
```kconfig
# Logging module configuration
CONFIG_LOG=y
CONFIG_LOG_BACKEND_UART=n
CONFIG_LOG_BACKEND_RTT=y

# GPIO Configuration
CONFIG_GPIO=y

# UART configuration
CONFIG_SERIAL=y
CONFIG_UART_ASYNC_API=y
```

## nrf52dk_nrf52832.overlay
```dts
// To get started, press Ctrl+Space to bring up the completion menu and view the available nodes.

// You can also use the buttons in the sidebar to perform actions on nodes.
// Actions currently available include:

// * Enabling / disabling the node
// * Adding the bus to a bus
// * Removing the node
// * Connecting ADC channels

// For more help, browse the DeviceTree documentation at https://docs.zephyrproject.org/latest/guides/dts/index.html
// You can also visit the nRF DeviceTree extension documentation at https://nrfconnect.github.io/vscode-nrf-connect/devicetree/nrfdevicetree.html

// uarttest:&uart0{
//     current-speed = < 115200 >;
//     tx-pin = < 27 >;
//     rx-pin = < 26 >;
// };
```

## src/main.c
```c
#include <stdio.h>
#include "zephyr/kernel.h"
#include "zephyr/logging/log.h"

#include "zephyr/drivers/uart.h"

// LOG_MODULE_DECLARE(main, LOG_LEVEL_DBG);
LOG_MODULE_REGISTER(main, LOG_LEVEL_INF);

const struct device *uart = DEVICE_DT_GET(DT_NODELABEL(uart0));

const struct uart_config uart0_config = {
    .baudrate=115200,
    .data_bits=UART_CFG_DATA_BITS_8,
    .flow_ctrl=UART_CFG_FLOW_CTRL_NONE,
    .parity=UART_CFG_PARITY_NONE,
    .stop_bits=UART_CFG_STOP_BITS_1
};

static void uart_send_data(uint8_t *str)
{
    while(*str)
        uart_poll_out(uart, *str++);
}

static void uart_get_data(uint8_t *str)
{
    do
    {

    }while(*str);
}

int main(void)
{
    if(!device_is_ready(uart))
    {
        LOG_ERR("Error in the UART0 initialization");
        return 1;
    }

    int err = uart_configure(uart, &uart0_config);
    if (err == -ENOSYS)
    {
        LOG_ERR("Error configuring the UART0.");
        return -ENOSYS;
    }

    unsigned char data_t[] = "Hello world using UART0 \r\n";     //Data to transmitt.
    unsigned char data_r[20] = {0};                     //Data to receive.

    LOG_INF("Hello world using RTT");

    while(1)
    {
        uart_send_data(data_t);             //Transmitt data

        // while(data_r[0] == 0)
        //     uart_poll_in(uart, &data_r[0]);

        // if(data_r[0] != 0)
        // {
        //     uart_poll_out(uart, data_r[0]);
        //     data_r[0] = 0;
        // }
        
        k_msleep(1000);
    }
    return 1;
}
```
